## prj.conf
```kconfig
CONFIG_HEAP_MEM_POOL_SIZE=16384
CONFIG_MAIN_STACK_SIZE=2048

CONFIG_DISPLAY=y
CONFIG_DISPLAY_LOG_LEVEL_ERR=y
CONFIG_LOG_STRDUP_BUF_COUNT=16

# Logging
CONFIG_LOG=y
CONFIG_LOG2_MODE_IMMEDIATE=y
CONFIG_LOG_MODE_MINIMAL=n
# 0 OFF, logging is turned off
# 1 ERROR, maximal level set to LOG_LEVEL_ERR
# 2 WARNING, maximal level set to LOG_LEVEL_WRN
# 3 INFO, maximal level set to LOG_LEVEL_INFO
# 4 DEBUG, maximal level set to LOG_LEVEL_DBG
CONFIG_LOG_MAX_LEVEL=4
CONFIG_LOG_DEFAULT_LEVEL=4
#CONFIG_LOG_PRINTK=y
#CONFIG_LOG_PRINTK_MAX_STRING_LENGTH=256
CONFIG_LOG_BACKEND_SHOW_COLOR=y
CONFIG_LOG_TIMESTAMP_64BIT=y
CONFIG_LOG_BACKEND_FORMAT_TIMESTAMP=y
CONFIG_LOG_FUNC_NAME_PREFIX_ERR=n
CONFIG_LOG_FUNC_NAME_PREFIX_WRN=n
CONFIG_LOG_FUNC_NAME_PREFIX_INF=n
CONFIG_LOG_FUNC_NAME_PREFIX_DBG=n
#CONFIG_APPLICATION_MODULE_LOG_LEVEL_DBG=y

CONFIG_LVGL=y
CONFIG_LVGL_LOG_LEVEL_DBG=y
CONFIG_LVGL_VDB_SIZE=100
CONFIG_LVGL_TXT_ENC_UTF8=y
CONFIG_LVGL_FONT_UNSCII_8=n
CONFIG_LVGL_FONT_MONTSERRAT_8=y
CONFIG_LVGL_FONT_MONTSERRAT_10=y
CONFIG_LVGL_FONT_MONTSERRAT_12=y
CONFIG_LVGL_FONT_MONTSERRAT_14=y
CONFIG_LVGL_FONT_MONTSERRAT_16=y
CONFIG_LVGL_FONT_MONTSERRAT_18=y
CONFIG_LVGL_FONT_MONTSERRAT_20=y
CONFIG_LVGL_FONT_MONTSERRAT_22=y
CONFIG_LVGL_FONT_MONTSERRAT_24=y
CONFIG_LVGL_THEME_DEFAULT_FONT_SMALL_MONTSERRAT_12=y
CONFIG_LVGL_THEME_DEFAULT_FONT_NORMAL_MONTSERRAT_14=y
CONFIG_LVGL_THEME_DEFAULT_FONT_SUBTITLE_MONTSERRAT_12=y
CONFIG_LVGL_THEME_DEFAULT_FONT_TITLE_MONTSERRAT_16=y

CONFIG_LVGL_USE_LABEL=y
CONFIG_LVGL_USE_IMG=y
CONFIG_LVGL_USE_CONT=n
CONFIG_LVGL_USE_BTN=n
CONFIG_LVGL_USE_THEME_EMPTY=n
CONFIG_LVGL_USE_THEME_MONO=n
CONFIG_LVGL_USE_THEME_MATERIAL=n
CONFIG_LVGL_THEME_DEFAULT_COLOR_PRIMARY_BLACK=y
CONFIG_LVGL_THEME_DEFAULT_COLOR_SECONDARY_WHITE=y
```

## src/main.c
```c
/*
 * Copyright (c) 2018 Jan Van Winkel <jan.van_winkel@dxplore.eu>
 *
 * SPDX-License-Identifier: Apache-2.0
 */

#include <device.h>
#include <drivers/display.h>
#include <lvgl.h>
#include <stdio.h>
#include <string.h>
#include <zephyr.h>

#define LOG_LEVEL CONFIG_LOG_DEFAULT_LEVEL
#include <logging/log.h>
LOG_MODULE_REGISTER(app);

void my_flush_cb(struct _disp_drv_t *disp_drv,
		const lv_area_t *area, lv_color_t *color_p)
{
	uint16_t w = area->x2 - area->x1 + 1;
	uint16_t h = area->y2 - area->y1 + 1;
	const struct device *display_dev = (const struct device *)disp_drv->user_data;
	struct display_capabilities cap;
	struct display_buffer_descriptor desc;

	display_get_capabilities(display_dev, &cap);

	desc.buf_size = (w * h)/8U;
	desc.width = w;
	desc.pitch = w;
	desc.height = h;

	display_write(display_dev, area->x1, area->y1, &desc, color_p);

	lv_disp_flush_ready(disp_drv);
}

LV_FONT_DECLARE(font_jet_brains_mono_bold_18);
LV_FONT_DECLARE(font_space_mono_regular_18);
LV_IMG_DECLARE(tictac);

void main(void)
{       
        LOG_INF("main() called.");

	lv_disp_t *lv_disp = lv_disp_get_default();
        lv_disp_drv_t lv_disp_drv = lv_disp->driver;

        lv_disp_drv.flush_cb   = my_flush_cb;

        lv_disp_drv_update(lv_disp, &lv_disp_drv);
        //static lv_style_t my_style;
        //lv_style_init(&my_style);
        //lv_style_set_text_font(&my_style, LV_STATE_DEFAULT, LV_FONT_MONTSERRAT_12);
        
        // Display Hello World
        lv_obj_t *hello_world_label;
        hello_world_label = lv_label_create(lv_scr_act(), NULL);
        //lv_obj_add_style(hello_world_label, 0, &my_style);
        //lv_obj_set_style_local_text_font(hello_world_label, LV_LABEL_PART_MAIN, LV_STATE_DEFAULT, &lv_font_montserrat_18);
        lv_obj_set_style_local_text_font(hello_world_label, LV_LABEL_PART_MAIN, LV_STATE_DEFAULT, &font_space_mono_regular_18);
        //lv_obj_report_style_mod(NULL);
        lv_obj_refresh_style(hello_world_label, LV_LABEL_PART_MAIN, LV_STYLE_PROP_ALL);
        //lv_label_set_text(hello_world_label, "Hallo Michael!");
        //lv_label_set_text(hello_world_label, LV_SYMBOL_OK " " "Hallo Michael!");
        lv_label_set_text(hello_world_label, "ÄÖÜäöüßá´`'#.,|");
        lv_obj_align(hello_world_label, NULL, LV_ALIGN_CENTER, 0, 0);
        lv_obj_set_width(hello_world_label, 200);
        lv_label_set_align(hello_world_label, LV_LABEL_ALIGN_LEFT);
        
        // display image
        /*
        lv_obj_t *tictac_img;
        tictac_img = lv_img_create(lv_scr_act(), NULL);
        lv_img_set_src(tictac_img,  &tictac);
        lv_obj_align(tictac_img, NULL, LV_ALIGN_CENTER, 0, 0);
        */
        

	lv_task_handler();
}
```

## src/font_jet_brains_mono_bold_18.c
```c
/*******************************************************************************
 * Size: 18 px
 * Bpp: 1
 * Opts: 
 ******************************************************************************/

#include <lvgl.h>

#ifndef FONT_JET_BRAINS_MONO_BOLD_18
#define FONT_JET_BRAINS_MONO_BOLD_18 1
#endif

#if FONT_JET_BRAINS_MONO_BOLD_18

/*-----------------
 *    BITMAPS
 *----------------*/

/*Store the image of the glyphs*/
static LV_ATTRIBUTE_LARGE_CONST const uint8_t glyph_bitmap[] = {
    /* U+0020 " " */
    0x0,

    /* U+0021 "!" */
    0x6d, 0xb6, 0xdb, 0x60, 0x7e,

    /* U+0022 "\"" */
    0xcf, 0x3c, 0xf3, 0xcc,

    /* U+0023 "#" */
    0x19, 0x86, 0x41, 0x11, 0xff, 0x7f, 0xc4, 0xc3,
    0x30, 0xc8, 0xff, 0xbf, 0xe2, 0x20, 0x98, 0x66,
    0x0,

    /* U+0024 "$" */
    0x8, 0x8, 0x3e, 0x7f, 0xcb, 0xc8, 0xe8, 0x7c,
    0x3e, 0xf, 0xb, 0xcb, 0xeb, 0x7e, 0x1c, 0x8,
    0x8,

    /* U+0025 "%" */
    0x70, 0x7f, 0x1b, 0x66, 0x6c, 0xcf, 0xb0, 0xec,
    0x1, 0x0, 0x7e, 0x1f, 0xe6, 0xcc, 0xd9, 0xb3,
    0xfc, 0x3c,

    /* U+0026 "&" */
    0x3c, 0x1f, 0x86, 0x31, 0x80, 0x60, 0xc, 0x7,
    0x83, 0x76, 0xcf, 0xb1, 0xcc, 0x73, 0xfe, 0x79,
    0x80,

    /* U+0027 "'" */
    0xff, 0xc0,

    /* U+0028 "(" */
    0xc, 0xf7, 0x18, 0xc3, 0xc, 0x30, 0xc3, 0xc,
    0x30, 0xc1, 0x87, 0xf, 0xc,

    /* U+0029 ")" */
    0xc3, 0xc3, 0x86, 0x1c, 0x30, 0xc3, 0xc, 0x30,
    0xc3, 0xc, 0x63, 0xbc, 0xc0,

    /* U+002A "*" */
    0xc, 0x3, 0x0, 0xc3, 0xbf, 0x7f, 0x83, 0x1,
    0xe0, 0xcc, 0x33, 0x0,

    /* U+002B "+" */
    0x18, 0xc, 0x6, 0x1f, 0xff, 0xf8, 0xc0, 0x60,
    0x30,

    /* U+002C "," */
    0x76, 0xec, 0xc0,

    /* U+002D "-" */
    0xff, 0xff,

    /* U+002E "." */
    0xff, 0xf0,

    /* U+002F "/" */
    0x3, 0x81, 0x81, 0xc0, 0xc0, 0x60, 0x70, 0x30,
    0x18, 0x1c, 0xc, 0xe, 0x6, 0x3, 0x3, 0x81,
    0x80, 0xc0, 0xe0, 0x0,

    /* U+0030 "0" */
    0x3c, 0x7e, 0xe7, 0xc3, 0xc3, 0xdb, 0xdb, 0xc3,
    0xc3, 0xc3, 0xe7, 0x7e, 0x3c,

    /* U+0031 "1" */
    0x1c, 0x7c, 0xec, 0xcc, 0xc, 0xc, 0xc, 0xc,
    0xc, 0xc, 0xc, 0xff, 0xff,

    /* U+0032 "2" */
    0x3c, 0x7e, 0xe7, 0xc3, 0x3, 0x7, 0x6, 0xc,
    0x38, 0x70, 0xe0, 0xff, 0xff,

    /* U+0033 "3" */
    0x7f, 0x7f, 0x7, 0xc, 0x18, 0x3e, 0xf, 0x3,
    0x3, 0xc3, 0xe7, 0x7e, 0x3c,

    /* U+0034 "4" */
    0x6, 0xc, 0x1c, 0x18, 0x30, 0x70, 0xe3, 0xc3,
    0xff, 0xff, 0x3, 0x3, 0x3,

    /* U+0035 "5" */
    0x7f, 0xbf, 0xd8, 0xc, 0x6, 0xe3, 0xf9, 0x8e,
    0x3, 0x1, 0x80, 0xd8, 0xef, 0xe3, 0xe0,

    /* U+0036 "6" */
    0xe, 0xe, 0x6, 0x7, 0x7, 0x3, 0x73, 0xfd,
    0xc7, 0xc1, 0xe0, 0xf8, 0xef, 0xe3, 0xe0,

    /* U+0037 "7" */
    0xff, 0xff, 0xf0, 0xd8, 0x60, 0x60, 0x30, 0x38,
    0x18, 0x1c, 0xc, 0x6, 0x7, 0x3, 0x0,

    /* U+0038 "8" */
    0x3c, 0x7e, 0xc3, 0xc3, 0xc3, 0x7e, 0x7e, 0xe7,
    0xc3, 0xc3, 0xe7, 0x7e, 0x3c,

    /* U+0039 "9" */
    0x3e, 0x3f, 0xb8, 0xf8, 0x3c, 0x1f, 0x1d, 0xfe,
    0x76, 0x7, 0x7, 0x3, 0x3, 0x83, 0x80,

    /* U+003A ":" */
    0xff, 0x80, 0x7, 0xfc,

    /* U+003B ";" */
    0x77, 0x70, 0x0, 0x0, 0x76, 0x6e, 0xc0,

    /* U+003C "<" */
    0x1, 0x7, 0x1f, 0x78, 0xe0, 0xe0, 0x78, 0x1e,
    0x7, 0x1,

    /* U+003D "=" */
    0xff, 0xff, 0x0, 0x0, 0xff, 0xff,

    /* U+003E ">" */
    0x80, 0xe0, 0xf8, 0x1e, 0x7, 0x7, 0x1e, 0x78,
    0xe0, 0x80,

    /* U+003F "?" */
    0xf9, 0xf8, 0x38, 0x30, 0xef, 0x9e, 0x30, 0x60,
    0x0, 0x3, 0x87, 0x0,

    /* U+0040 "@" */
    0x1f, 0x1f, 0xe6, 0x1f, 0x3, 0xcf, 0xf7, 0xfd,
    0x8f, 0x63, 0xd8, 0xf6, 0x3d, 0x8f, 0x3f, 0xc0,
    0x18, 0x7, 0xc0, 0x70,

    /* U+0041 "A" */
    0x1c, 0xe, 0xf, 0x6, 0xc3, 0x61, 0xb1, 0x9c,
    0xc6, 0x7f, 0x7f, 0xb8, 0xf8, 0x7c, 0x18,

    /* U+0042 "B" */
    0xfc, 0xff, 0xc3, 0xc3, 0xc3, 0xfe, 0xfe, 0xc7,
    0xc3, 0xc3, 0xc7, 0xfe, 0xfc,

    /* U+0043 "C" */
    0x3c, 0x7e, 0xe7, 0xc3, 0xc0, 0xc0, 0xc0, 0xc0,
    0xc0, 0xc3, 0xe7, 0x7e, 0x3c,

    /* U+0044 "D" */
    0xfc, 0xfe, 0xc7, 0xc3, 0xc3, 0xc3, 0xc3, 0xc3,
    0xc3, 0xc3, 0xc7, 0xfe, 0xfc,

    /* U+0045 "E" */
    0xff, 0xff, 0xc0, 0xc0, 0xc0, 0xff, 0xff, 0xc0,
    0xc0, 0xc0, 0xc0, 0xff, 0xff,

    /* U+0046 "F" */
    0xff, 0xff, 0xc0, 0xc0, 0xc0, 0xc0, 0xff, 0xff,
    0xc0, 0xc0, 0xc0, 0xc0, 0xc0,

    /* U+0047 "G" */
    0x3c, 0x7e, 0xe7, 0xc3, 0xc0, 0xc0, 0xcf, 0xcf,
    0xc3, 0xc3, 0xe7, 0x7e, 0x3c,

    /* U+0048 "H" */
    0xc3, 0xc3, 0xc3, 0xc3, 0xc3, 0xff, 0xff, 0xc3,
    0xc3, 0xc3, 0xc3, 0xc3, 0xc3,

    /* U+0049 "I" */
    0xff, 0xff, 0x18, 0x18, 0x18, 0x18, 0x18, 0x18,
    0x18, 0x18, 0x18, 0xff, 0xff,

    /* U+004A "J" */
    0x1f, 0x8f, 0xc0, 0x60, 0x30, 0x18, 0xc, 0x6,
    0x3, 0x1, 0xe0, 0xf8, 0xef, 0xe3, 0xe0,

    /* U+004B "K" */
    0xc3, 0x63, 0xb1, 0x99, 0xcc, 0xc7, 0xe3, 0xf1,
    0x98, 0xce, 0x63, 0x31, 0xd8, 0xec, 0x30,

    /* U+004C "L" */
    0xc0, 0xc0, 0xc0, 0xc0, 0xc0, 0xc0, 0xc0, 0xc0,
    0xc0, 0xc0, 0xc0, 0xff, 0xff,

    /* U+004D "M" */
    0xe3, 0xf1, 0xf8, 0xfe, 0xff, 0x7e, 0xaf, 0x77,
    0x83, 0xc1, 0xe0, 0xf0, 0x78, 0x3c, 0x18,

    /* U+004E "N" */
    0xe3, 0xe3, 0xf3, 0xf3, 0xf3, 0xdb, 0xdb, 0xdb,
    0xcf, 0xcf, 0xcf, 0xc7, 0xc7,

    /* U+004F "O" */
    0x3c, 0x7e, 0xc7, 0xc3, 0xc3, 0xc3, 0xc3, 0xc3,
    0xc3, 0xc3, 0xe7, 0x7e, 0x3c,

    /* U+0050 "P" */
    0xfe, 0x7f, 0xb0, 0xf8, 0x3c, 0x1e, 0x1f, 0xfd,
    0xfc, 0xc0, 0x60, 0x30, 0x18, 0xc, 0x0,

    /* U+0051 "Q" */
    0x3c, 0x7e, 0xe7, 0xc3, 0xc3, 0xc3, 0xc3, 0xc3,
    0xc3, 0xc3, 0xe7, 0x7e, 0x3c, 0xe, 0x6, 0x3,

    /* U+0052 "R" */
    0xfc, 0xfe, 0xc7, 0xc3, 0xc3, 0xc7, 0xfe, 0xfc,
    0xcc, 0xce, 0xc6, 0xc7, 0xc3,

    /* U+0053 "S" */
    0x3e, 0x3f, 0xb8, 0xf8, 0x3c, 0x3, 0xc0, 0xf8,
    0xe, 0x1, 0xe0, 0xf8, 0xef, 0xe3, 0xe0,

    /* U+0054 "T" */
    0xff, 0xff, 0xc3, 0x1, 0x80, 0xc0, 0x60, 0x30,
    0x18, 0xc, 0x6, 0x3, 0x1, 0x80, 0xc0,

    /* U+0055 "U" */
    0xc3, 0xc3, 0xc3, 0xc3, 0xc3, 0xc3, 0xc3, 0xc3,
    0xc3, 0xc3, 0xe7, 0x7e, 0x3c,

    /* U+0056 "V" */
    0xc1, 0xe0, 0xf8, 0xec, 0x66, 0x33, 0x19, 0xdc,
    0x6c, 0x36, 0x1b, 0xd, 0x83, 0x81, 0xc0,

    /* U+0057 "W" */
    0xcc, 0xf3, 0x3c, 0xad, 0x2b, 0x6a, 0xda, 0xb6,
    0xad, 0xeb, 0x7a, 0x9e, 0xa7, 0x39, 0xce, 0x73,
    0x80,

    /* U+0058 "X" */
    0x61, 0xcc, 0x63, 0xb8, 0x6c, 0x1f, 0x3, 0x80,
    0xe0, 0x38, 0x1f, 0xe, 0xc3, 0x39, 0xc6, 0x60,
    0xc0,

    /* U+0059 "Y" */
    0xe1, 0xd8, 0x67, 0x38, 0xcc, 0x33, 0x7, 0x81,
    0xe0, 0x30, 0xc, 0x3, 0x0, 0xc0, 0x30, 0xc,
    0x0,

    /* U+005A "Z" */
    0xff, 0xff, 0x7, 0x6, 0xe, 0x1c, 0x18, 0x38,
    0x70, 0x60, 0xe0, 0xff, 0xff,

    /* U+005B "[" */
    0xff, 0xf1, 0x8c, 0x63, 0x18, 0xc6, 0x31, 0x8c,
    0x63, 0x1f, 0xf8,

    /* U+005C "\\" */
    0xe0, 0x30, 0x18, 0xe, 0x3, 0x1, 0x80, 0xe0,
    0x30, 0x1c, 0x6, 0x3, 0x1, 0xc0, 0x60, 0x30,
    0x1c, 0x6, 0x3, 0x80,

    /* U+005D "]" */
    0xff, 0xc6, 0x31, 0x8c, 0x63, 0x18, 0xc6, 0x31,
    0x8c, 0x7f, 0xf8,

    /* U+005E "^" */
    0x1c, 0xe, 0xd, 0x86, 0xc6, 0x63, 0x1b, 0x8c,

    /* U+005F "_" */
    0xff, 0xff, 0xc0,

    /* U+0060 "`" */
    0xe3,

    /* U+0061 "a" */
    0x3c, 0x7f, 0xe3, 0x3, 0x7f, 0xff, 0xc3, 0xc3,
    0xff, 0x7b,

    /* U+0062 "b" */
    0xc0, 0xc0, 0xc0, 0xde, 0xfe, 0xe7, 0xc3, 0xc3,
    0xc3, 0xc3, 0xe7, 0xfe, 0xdc,

    /* U+0063 "c" */
    0x3c, 0x7e, 0xe3, 0xc3, 0xc0, 0xc0, 0xc3, 0xe3,
    0x7e, 0x3c,

    /* U+0064 "d" */
    0x3, 0x3, 0x3, 0x7b, 0x7f, 0xe7, 0xc3, 0xc3,
    0xc3, 0xc3, 0xe7, 0xff, 0x7b,

    /* U+0065 "e" */
    0x3c, 0x7e, 0xc3, 0xc3, 0xff, 0xff, 0xc0, 0xc3,
    0x7e, 0x3c,

    /* U+0066 "f" */
    0xf, 0x8f, 0xc6, 0x1f, 0xff, 0xf8, 0xc0, 0x60,
    0x30, 0x18, 0xc, 0x6, 0x3, 0x1, 0x80,

    /* U+0067 "g" */
    0x7b, 0xff, 0xc7, 0xc3, 0xc3, 0xc3, 0xc7, 0xff,
    0x7b, 0x3, 0x3, 0x7f, 0x7e,

    /* U+0068 "h" */
    0xc0, 0xc0, 0xc0, 0xde, 0xff, 0xe7, 0xc3, 0xc3,
    0xc3, 0xc3, 0xc3, 0xc3, 0xc3,

    /* U+0069 "i" */
    0x8, 0xe, 0x2, 0x0, 0xf, 0xc7, 0xe0, 0x30,
    0x18, 0xc, 0x6, 0x3, 0x1, 0x8f, 0xff, 0xfc,

    /* U+006A "j" */
    0x4, 0x1c, 0x10, 0x7, 0xcf, 0x83, 0x6, 0xc,
    0x18, 0x30, 0x60, 0xc1, 0x83, 0x7c, 0xf0,

    /* U+006B "k" */
    0xc0, 0xc0, 0xc0, 0xc3, 0xc7, 0xce, 0xcc, 0xfc,
    0xfc, 0xcc, 0xce, 0xc7, 0xc3,

    /* U+006C "l" */
    0xf8, 0x3e, 0x1, 0x80, 0x60, 0x18, 0x6, 0x1,
    0x80, 0x60, 0x18, 0x6, 0x1, 0x80, 0x7f, 0xf,
    0xc0,

    /* U+006D "m" */
    0xf3, 0x7f, 0xf6, 0x7b, 0x3d, 0x9e, 0xcf, 0x67,
    0xb3, 0xd9, 0xec, 0xc0,

    /* U+006E "n" */
    0xde, 0xff, 0xe7, 0xc3, 0xc3, 0xc3, 0xc3, 0xc3,
    0xc3, 0xc3,

    /* U+006F "o" */
    0x3c, 0x7e, 0xe7, 0xc3, 0xc3, 0xc3, 0xc3, 0xe7,
    0x7e, 0x3c,

    /* U+0070 "p" */
    0xde, 0xfe, 0xe7, 0xc3, 0xc3, 0xc3, 0xc3, 0xe7,
    0xfe, 0xdc, 0xc0, 0xc0, 0xc0,

    /* U+0071 "q" */
    0x7b, 0x7f, 0xe7, 0xc3, 0xc3, 0xc3, 0xc3, 0xe7,
    0x7f, 0x7b, 0x3, 0x3, 0x3,

    /* U+0072 "r" */
    0xde, 0xfe, 0xe7, 0xc3, 0xc3, 0xc0, 0xc0, 0xc0,
    0xc0, 0xc0,

    /* U+0073 "s" */
    0x7c, 0xfe, 0xc3, 0xc0, 0x7c, 0x1e, 0x3, 0xc3,
    0xff, 0x7e,

    /* U+0074 "t" */
    0x18, 0xc, 0x6, 0x1f, 0xff, 0xf8, 0xc0, 0x60,
    0x30, 0x18, 0xc, 0x6, 0x3, 0xf0, 0xf8,

    /* U+0075 "u" */
    0xc3, 0xc3, 0xc3, 0xc3, 0xc3, 0xc3, 0xc3, 0xe7,
    0x7e, 0x3c,

    /* U+0076 "v" */
    0xc1, 0xf1, 0xd8, 0xcc, 0x66, 0x73, 0xb0, 0xd8,
    0x6c, 0x3c, 0xe, 0x0,

    /* U+0077 "w" */
    0xcc, 0x53, 0xb6, 0xad, 0xab, 0x6a, 0xda, 0xb6,
    0xa9, 0xea, 0x33, 0x8c, 0xe0,

    /* U+0078 "x" */
    0xe3, 0xb3, 0x8d, 0x87, 0xc1, 0xc0, 0xe0, 0xf8,
    0xec, 0x63, 0x71, 0xc0,

    /* U+0079 "y" */
    0xc1, 0xf1, 0xd8, 0xcc, 0x63, 0x61, 0xb0, 0xd8,
    0x38, 0x1c, 0xe, 0x6, 0x3, 0x3, 0x80,

    /* U+007A "z" */
    0xff, 0xff, 0x7, 0xe, 0x1c, 0x38, 0x70, 0xe0,
    0xff, 0xff,

    /* U+007B "{" */
    0x7, 0x87, 0xc3, 0x1, 0x80, 0xc0, 0x60, 0x30,
    0x18, 0xf8, 0x7c, 0x3, 0x1, 0x80, 0xc0, 0x60,
    0x30, 0x1f, 0x7, 0x80,

    /* U+007C "|" */
    0xff, 0xff, 0xff, 0xff, 0xc0,

    /* U+007D "}" */
    0xe0, 0xf0, 0x30, 0x30, 0x30, 0x30, 0x30, 0x30,
    0x1f, 0x1f, 0x30, 0x30, 0x30, 0x30, 0x30, 0xf0,
    0xe0,

    /* U+007E "~" */
    0x71, 0xfc, 0xf3, 0xf8, 0xe0,

    /* U+00C4 "Ä" */
    0x66, 0x66, 0x0, 0x0, 0x3c, 0x3c, 0x3c, 0x3c,
    0x66, 0x66, 0x66, 0x66, 0x7e, 0xff, 0xc3, 0xc3,
    0xc3
};


/*---------------------
 *  GLYPH DESCRIPTION
 *--------------------*/

static const lv_font_fmt_txt_glyph_dsc_t glyph_dsc[] = {
    {.bitmap_index = 0, .adv_w = 0, .box_w = 0, .box_h = 0, .ofs_x = 0, .ofs_y = 0} /* id = 0 reserved */,
    {.bitmap_index = 0, .adv_w = 173, .box_w = 1, .box_h = 1, .ofs_x = 0, .ofs_y = 0},
    {.bitmap_index = 1, .adv_w = 173, .box_w = 3, .box_h = 13, .ofs_x = 4, .ofs_y = 0},
    {.bitmap_index = 6, .adv_w = 173, .box_w = 6, .box_h = 5, .ofs_x = 2, .ofs_y = 8},
    {.bitmap_index = 10, .adv_w = 173, .box_w = 10, .box_h = 13, .ofs_x = 1, .ofs_y = 0},
    {.bitmap_index = 27, .adv_w = 173, .box_w = 8, .box_h = 17, .ofs_x = 1, .ofs_y = -2},
    {.bitmap_index = 44, .adv_w = 173, .box_w = 11, .box_h = 13, .ofs_x = 1, .ofs_y = 0},
    {.bitmap_index = 62, .adv_w = 173, .box_w = 10, .box_h = 13, .ofs_x = 1, .ofs_y = 0},
    {.bitmap_index = 79, .adv_w = 173, .box_w = 2, .box_h = 5, .ofs_x = 4, .ofs_y = 8},
    {.bitmap_index = 81, .adv_w = 173, .box_w = 6, .box_h = 17, .ofs_x = 3, .ofs_y = -2},
    {.bitmap_index = 94, .adv_w = 173, .box_w = 6, .box_h = 17, .ofs_x = 2, .ofs_y = -2},
    {.bitmap_index = 107, .adv_w = 173, .box_w = 10, .box_h = 9, .ofs_x = 0, .ofs_y = 2},
    {.bitmap_index = 119, .adv_w = 173, .box_w = 9, .box_h = 8, .ofs_x = 1, .ofs_y = 2},
    {.bitmap_index = 128, .adv_w = 173, .box_w = 4, .box_h = 5, .ofs_x = 3, .ofs_y = -3},
    {.bitmap_index = 131, .adv_w = 173, .box_w = 8, .box_h = 2, .ofs_x = 1, .ofs_y = 5},
    {.bitmap_index = 133, .adv_w = 173, .box_w = 4, .box_h = 3, .ofs_x = 4, .ofs_y = 0},
    {.bitmap_index = 135, .adv_w = 173, .box_w = 9, .box_h = 17, .ofs_x = 1, .ofs_y = -2},
    {.bitmap_index = 155, .adv_w = 173, .box_w = 8, .box_h = 13, .ofs_x = 1, .ofs_y = 0},
    {.bitmap_index = 168, .adv_w = 173, .box_w = 8, .box_h = 13, .ofs_x = 2, .ofs_y = 0},
    {.bitmap_index = 181, .adv_w = 173, .box_w = 8, .box_h = 13, .ofs_x = 1, .ofs_y = 0},
    {.bitmap_index = 194, .adv_w = 173, .box_w = 8, .box_h = 13, .ofs_x = 1, .ofs_y = 0},
    {.bitmap_index = 207, .adv_w = 173, .box_w = 8, .box_h = 13, .ofs_x = 1, .ofs_y = 0},
    {.bitmap_index = 220, .adv_w = 173, .box_w = 9, .box_h = 13, .ofs_x = 1, .ofs_y = 0},
    {.bitmap_index = 235, .adv_w = 173, .box_w = 9, .box_h = 13, .ofs_x = 1, .ofs_y = 0},
    {.bitmap_index = 250, .adv_w = 173, .box_w = 9, .box_h = 13, .ofs_x = 1, .ofs_y = 0},
    {.bitmap_index = 265, .adv_w = 173, .box_w = 8, .box_h = 13, .ofs_x = 1, .ofs_y = 0},
    {.bitmap_index = 278, .adv_w = 173, .box_w = 9, .box_h = 13, .ofs_x = 1, .ofs_y = 0},
    {.bitmap_index = 293, .adv_w = 173, .box_w = 3, .box_h = 10, .ofs_x = 4, .ofs_y = 0},
    {.bitmap_index = 297, .adv_w = 173, .box_w = 4, .box_h = 13, .ofs_x = 3, .ofs_y = -3},
    {.bitmap_index = 304, .adv_w = 173, .box_w = 8, .box_h = 10, .ofs_x = 1, .ofs_y = 1},
    {.bitmap_index = 314, .adv_w = 173, .box_w = 8, .box_h = 6, .ofs_x = 1, .ofs_y = 3},
    {.bitmap_index = 320, .adv_w = 173, .box_w = 8, .box_h = 10, .ofs_x = 1, .ofs_y = 1},
    {.bitmap_index = 330, .adv_w = 173, .box_w = 7, .box_h = 13, .ofs_x = 2, .ofs_y = 0},
    {.bitmap_index = 342, .adv_w = 173, .box_w = 10, .box_h = 16, .ofs_x = 1, .ofs_y = -3},
    {.bitmap_index = 362, .adv_w = 173, .box_w = 9, .box_h = 13, .ofs_x = 1, .ofs_y = 0},
    {.bitmap_index = 377, .adv_w = 173, .box_w = 8, .box_h = 13, .ofs_x = 1, .ofs_y = 0},
    {.bitmap_index = 390, .adv_w = 173, .box_w = 8, .box_h = 13, .ofs_x = 1, .ofs_y = 0},
    {.bitmap_index = 403, .adv_w = 173, .box_w = 8, .box_h = 13, .ofs_x = 1, .ofs_y = 0},
    {.bitmap_index = 416, .adv_w = 173, .box_w = 8, .box_h = 13, .ofs_x = 2, .ofs_y = 0},
    {.bitmap_index = 429, .adv_w = 173, .box_w = 8, .box_h = 13, .ofs_x = 1, .ofs_y = 0},
    {.bitmap_index = 442, .adv_w = 173, .box_w = 8, .box_h = 13, .ofs_x = 1, .ofs_y = 0},
    {.bitmap_index = 455, .adv_w = 173, .box_w = 8, .box_h = 13, .ofs_x = 1, .ofs_y = 0},
    {.bitmap_index = 468, .adv_w = 173, .box_w = 8, .box_h = 13, .ofs_x = 2, .ofs_y = 0},
    {.bitmap_index = 481, .adv_w = 173, .box_w = 9, .box_h = 13, .ofs_x = 1, .ofs_y = 0},
    {.bitmap_index = 496, .adv_w = 173, .box_w = 9, .box_h = 13, .ofs_x = 1, .ofs_y = 0},
    {.bitmap_index = 511, .adv_w = 173, .box_w = 8, .box_h = 13, .ofs_x = 2, .ofs_y = 0},
    {.bitmap_index = 524, .adv_w = 173, .box_w = 9, .box_h = 13, .ofs_x = 1, .ofs_y = 0},
    {.bitmap_index = 539, .adv_w = 173, .box_w = 8, .box_h = 13, .ofs_x = 1, .ofs_y = 0},
    {.bitmap_index = 552, .adv_w = 173, .box_w = 8, .box_h = 13, .ofs_x = 1, .ofs_y = 0},
    {.bitmap_index = 565, .adv_w = 173, .box_w = 9, .box_h = 13, .ofs_x = 1, .ofs_y = 0},
    {.bitmap_index = 580, .adv_w = 173, .box_w = 8, .box_h = 16, .ofs_x = 1, .ofs_y = -3},
    {.bitmap_index = 596, .adv_w = 173, .box_w = 8, .box_h = 13, .ofs_x = 1, .ofs_y = 0},
    {.bitmap_index = 609, .adv_w = 173, .box_w = 9, .box_h = 13, .ofs_x = 1, .ofs_y = 0},
    {.bitmap_index = 624, .adv_w = 173, .box_w = 9, .box_h = 13, .ofs_x = 1, .ofs_y = 0},
    {.bitmap_index = 639, .adv_w = 173, .box_w = 8, .box_h = 13, .ofs_x = 1, .ofs_y = 0},
    {.bitmap_index = 652, .adv_w = 173, .box_w = 9, .box_h = 13, .ofs_x = 1, .ofs_y = 0},
    {.bitmap_index = 667, .adv_w = 173, .box_w = 10, .box_h = 13, .ofs_x = 0, .ofs_y = 0},
    {.bitmap_index = 684, .adv_w = 173, .box_w = 10, .box_h = 13, .ofs_x = 0, .ofs_y = 0},
    {.bitmap_index = 701, .adv_w = 173, .box_w = 10, .box_h = 13, .ofs_x = 0, .ofs_y = 0},
    {.bitmap_index = 718, .adv_w = 173, .box_w = 8, .box_h = 13, .ofs_x = 1, .ofs_y = 0},
    {.bitmap_index = 731, .adv_w = 173, .box_w = 5, .box_h = 17, .ofs_x = 3, .ofs_y = -2},
    {.bitmap_index = 742, .adv_w = 173, .box_w = 9, .box_h = 17, .ofs_x = 1, .ofs_y = -2},
    {.bitmap_index = 762, .adv_w = 173, .box_w = 5, .box_h = 17, .ofs_x = 2, .ofs_y = -2},
    {.bitmap_index = 773, .adv_w = 173, .box_w = 9, .box_h = 7, .ofs_x = 1, .ofs_y = 6},
    {.bitmap_index = 781, .adv_w = 173, .box_w = 9, .box_h = 2, .ofs_x = 1, .ofs_y = -2},
    {.bitmap_index = 784, .adv_w = 173, .box_w = 4, .box_h = 2, .ofs_x = 3, .ofs_y = 12},
    {.bitmap_index = 785, .adv_w = 173, .box_w = 8, .box_h = 10, .ofs_x = 1, .ofs_y = 0},
    {.bitmap_index = 795, .adv_w = 173, .box_w = 8, .box_h = 13, .ofs_x = 1, .ofs_y = 0},
    {.bitmap_index = 808, .adv_w = 173, .box_w = 8, .box_h = 10, .ofs_x = 1, .ofs_y = 0},
    {.bitmap_index = 818, .adv_w = 173, .box_w = 8, .box_h = 13, .ofs_x = 1, .ofs_y = 0},
    {.bitmap_index = 831, .adv_w = 173, .box_w = 8, .box_h = 10, .ofs_x = 1, .ofs_y = 0},
    {.bitmap_index = 841, .adv_w = 173, .box_w = 9, .box_h = 13, .ofs_x = 1, .ofs_y = 0},
    {.bitmap_index = 856, .adv_w = 173, .box_w = 8, .box_h = 13, .ofs_x = 1, .ofs_y = -3},
    {.bitmap_index = 869, .adv_w = 173, .box_w = 8, .box_h = 13, .ofs_x = 1, .ofs_y = 0},
    {.bitmap_index = 882, .adv_w = 173, .box_w = 9, .box_h = 14, .ofs_x = 1, .ofs_y = 0},
    {.bitmap_index = 898, .adv_w = 173, .box_w = 7, .box_h = 17, .ofs_x = 1, .ofs_y = -3},
    {.bitmap_index = 913, .adv_w = 173, .box_w = 8, .box_h = 13, .ofs_x = 1, .ofs_y = 0},
    {.bitmap_index = 926, .adv_w = 173, .box_w = 10, .box_h = 13, .ofs_x = 1, .ofs_y = 0},
    {.bitmap_index = 943, .adv_w = 173, .box_w = 9, .box_h = 10, .ofs_x = 1, .ofs_y = 0},
    {.bitmap_index = 955, .adv_w = 173, .box_w = 8, .box_h = 10, .ofs_x = 1, .ofs_y = 0},
    {.bitmap_index = 965, .adv_w = 173, .box_w = 8, .box_h = 10, .ofs_x = 1, .ofs_y = 0},
    {.bitmap_index = 975, .adv_w = 173, .box_w = 8, .box_h = 13, .ofs_x = 1, .ofs_y = -3},
    {.bitmap_index = 988, .adv_w = 173, .box_w = 8, .box_h = 13, .ofs_x = 1, .ofs_y = -3},
    {.bitmap_index = 1001, .adv_w = 173, .box_w = 8, .box_h = 10, .ofs_x = 2, .ofs_y = 0},
    {.bitmap_index = 1011, .adv_w = 173, .box_w = 8, .box_h = 10, .ofs_x = 1, .ofs_y = 0},
    {.bitmap_index = 1021, .adv_w = 173, .box_w = 9, .box_h = 13, .ofs_x = 1, .ofs_y = 0},
    {.bitmap_index = 1036, .adv_w = 173, .box_w = 8, .box_h = 10, .ofs_x = 1, .ofs_y = 0},
    {.bitmap_index = 1046, .adv_w = 173, .box_w = 9, .box_h = 10, .ofs_x = 1, .ofs_y = 0},
    {.bitmap_index = 1058, .adv_w = 173, .box_w = 10, .box_h = 10, .ofs_x = 0, .ofs_y = 0},
    {.bitmap_index = 1071, .adv_w = 173, .box_w = 9, .box_h = 10, .ofs_x = 1, .ofs_y = 0},
    {.bitmap_index = 1083, .adv_w = 173, .box_w = 9, .box_h = 13, .ofs_x = 1, .ofs_y = -3},
    {.bitmap_index = 1098, .adv_w = 173, .box_w = 8, .box_h = 10, .ofs_x = 1, .ofs_y = 0},
    {.bitmap_index = 1108, .adv_w = 173, .box_w = 9, .box_h = 17, .ofs_x = 1, .ofs_y = -2},
    {.bitmap_index = 1128, .adv_w = 173, .box_w = 2, .box_h = 17, .ofs_x = 4, .ofs_y = -2},
    {.bitmap_index = 1133, .adv_w = 173, .box_w = 8, .box_h = 17, .ofs_x = 1, .ofs_y = -2},
    {.bitmap_index = 1150, .adv_w = 173, .box_w = 9, .box_h = 4, .ofs_x = 1, .ofs_y = 4},
    {.bitmap_index = 1155, .adv_w = 173, .box_w = 8, .box_h = 17, .ofs_x = 1, .ofs_y = 0}
};

/*---------------------
 *  CHARACTER MAPPING
 *--------------------*/



/*Collect the unicode lists and glyph_id offsets*/
static const lv_font_fmt_txt_cmap_t cmaps[] =
{
    {
        .range_start = 32, .range_length = 95, .glyph_id_start = 1,
        .unicode_list = NULL, .glyph_id_ofs_list = NULL, .list_length = 0, .type = LV_FONT_FMT_TXT_CMAP_FORMAT0_TINY
    },
    {
        .range_start = 196, .range_length = 1, .glyph_id_start = 96,
        .unicode_list = NULL, .glyph_id_ofs_list = NULL, .list_length = 0, .type = LV_FONT_FMT_TXT_CMAP_FORMAT0_TINY
    }
};



/*--------------------
 *  ALL CUSTOM DATA
 *--------------------*/

#if LV_VERSION_CHECK(8, 0, 0)
/*Store all the custom data of the font*/
static  lv_font_fmt_txt_glyph_cache_t cache;
static const lv_font_fmt_txt_dsc_t font_dsc = {
#else
static lv_font_fmt_txt_dsc_t font_dsc = {
#endif
    .glyph_bitmap = glyph_bitmap,
    .glyph_dsc = glyph_dsc,
    .cmaps = cmaps,
    .kern_dsc = NULL,
    .kern_scale = 0,
    .cmap_num = 2,
    .bpp = 1,
    .kern_classes = 0,
    .bitmap_format = 0,
#if LV_VERSION_CHECK(8, 0, 0)
    .cache = &cache
#endif
};


/*-----------------
 *  PUBLIC FONT
 *----------------*/

/*Initialize a public general font descriptor*/
#if LV_VERSION_CHECK(8, 0, 0)
const lv_font_t font_jet_brains_mono_bold_18 = {
#else
lv_font_t font_jet_brains_mono_bold_18 = {
#endif
    .get_glyph_dsc = lv_font_get_glyph_dsc_fmt_txt,    /*Function pointer to get glyph's data*/
    .get_glyph_bitmap = lv_font_get_bitmap_fmt_txt,    /*Function pointer to get glyph's bitmap*/
    .line_height = 20,          /*The maximum line height required by the font*/
    .base_line = 3,             /*Baseline measured from the bottom of the line*/
#if !(LVGL_VERSION_MAJOR == 6 && LVGL_VERSION_MINOR == 0)
    .subpx = LV_FONT_SUBPX_NONE,
#endif
#if LV_VERSION_CHECK(7, 4, 0) || LVGL_VERSION_MAJOR >= 8
    .underline_position = -2,
    .underline_thickness = 1,
#endif
    .dsc = &font_dsc           /*The custom font data. Will be accessed by `get_glyph_bitmap/dsc` */
};



#endif /*#if FONT_JET_BRAINS_MONO_BOLD_18*/
```

## src/font_space_mono_regular_18.c
```c
/*******************************************************************************
 * Size: 18 px
 * Bpp: 1
 * Opts: 
 ******************************************************************************/

#include <lvgl.h>

#ifndef FONT_SPACE_MONO_REGULAR_18
#define FONT_SPACE_MONO_REGULAR_18 1
#endif

#if FONT_SPACE_MONO_REGULAR_18

/*-----------------
 *    BITMAPS
 *----------------*/

/*Store the image of the glyphs*/
static LV_ATTRIBUTE_LARGE_CONST const uint8_t glyph_bitmap[] = {
    /* U+0020 " " */
    0x0,

    /* U+0021 "!" */
    0x49, 0x24, 0x92, 0x43, 0xf0,

    /* U+0022 "\"" */
    0xff, 0xf4, 0x92,

    /* U+0023 "#" */
    0x24, 0x24, 0x24, 0xff, 0x24, 0x24, 0xff, 0x24,
    0x24,

    /* U+0024 "$" */
    0x10, 0xf3, 0x7c, 0x9d, 0xf, 0xa4, 0xc9, 0xd6,
    0x78, 0x40,

    /* U+0025 "%" */
    0x70, 0x44, 0x22, 0x11, 0x17, 0x30, 0x60, 0x40,
    0xce, 0x88, 0x84, 0x42, 0x20, 0xe0,

    /* U+0026 "&" */
    0x3e, 0x30, 0x8, 0x2, 0x4, 0xc1, 0xf, 0xf4,
    0x12, 0x4, 0x81, 0x20, 0x44, 0x10, 0xfc,

    /* U+0027 "'" */
    0xfd, 0x20,

    /* U+0028 "(" */
    0xe, 0x61, 0x82, 0x8, 0x10, 0x20, 0x40, 0x81,
    0x2, 0x4, 0x8, 0x10, 0x10, 0x30, 0x30, 0x1c,

    /* U+0029 ")" */
    0xe0, 0x30, 0x30, 0x20, 0x20, 0x40, 0x81, 0x2,
    0x4, 0x8, 0x10, 0x20, 0x41, 0x6, 0x19, 0xc0,

    /* U+002A "*" */
    0x8, 0x24, 0x8a, 0x83, 0x8f, 0xf8, 0xe0, 0xa8,
    0x92, 0x8, 0x0,

    /* U+002B "+" */
    0x10, 0x10, 0x10, 0xff, 0x10, 0x10, 0x10,

    /* U+002C "," */
    0xdd, 0xe0,

    /* U+002D "-" */
    0xf8,

    /* U+002E "." */
    0xfc,

    /* U+002F "/" */
    0x6, 0x8, 0x10, 0x60, 0x81, 0x6, 0x8, 0x10,
    0x60, 0x81, 0x6, 0x8, 0x10, 0x60,

    /* U+0030 "0" */
    0x3e, 0x31, 0xb0, 0x70, 0x18, 0xc, 0xc6, 0x63,
    0x1, 0x80, 0xc0, 0xd0, 0x47, 0xc0,

    /* U+0031 "1" */
    0x38, 0x1c, 0x1a, 0x9, 0xc, 0x84, 0x40, 0x20,
    0x10, 0x8, 0x4, 0x2, 0x1f, 0xf0,

    /* U+0032 "2" */
    0x3c, 0x42, 0x81, 0x81, 0x81, 0x3, 0x1e, 0x78,
    0xc0, 0x80, 0x80, 0xff,

    /* U+0033 "3" */
    0xff, 0x1, 0x6, 0xc, 0x10, 0x1e, 0x3, 0x81,
    0x81, 0x81, 0x42, 0x3c,

    /* U+0034 "4" */
    0xe, 0x5, 0x6, 0x86, 0x42, 0x23, 0x11, 0x9,
    0x4, 0xff, 0x81, 0x0, 0x80, 0x40,

    /* U+0035 "5" */
    0xfe, 0x80, 0x80, 0xbc, 0xa2, 0xe1, 0x1, 0x81,
    0x81, 0x83, 0x42, 0x3c,

    /* U+0036 "6" */
    0x3c, 0x42, 0x81, 0x80, 0xbc, 0xc2, 0x81, 0x81,
    0x81, 0x81, 0x42, 0x3c,

    /* U+0037 "7" */
    0xff, 0x1, 0x3, 0x2, 0x4, 0xc, 0x8, 0x10,
    0x30, 0x20, 0x40, 0x40,

    /* U+0038 "8" */
    0x3e, 0x63, 0x41, 0x41, 0x63, 0x3e, 0x43, 0x81,
    0x81, 0x81, 0x42, 0x3c,

    /* U+0039 "9" */
    0x3c, 0x42, 0x81, 0x81, 0x81, 0x43, 0x3d, 0x1,
    0x81, 0x81, 0x42, 0x3c,

    /* U+003A ":" */
    0xfc, 0x0, 0x7, 0xe0,

    /* U+003B ";" */
    0xfc, 0x0, 0x7, 0xe7, 0x80,

    /* U+003C "<" */
    0x3, 0x1e, 0xf0, 0xc0, 0xe0, 0x78, 0xf, 0x1,

    /* U+003D "=" */
    0xff, 0x0, 0x0, 0xff,

    /* U+003E ">" */
    0xc0, 0xf8, 0x1f, 0x3, 0x7, 0x3e, 0xf0, 0x80,

    /* U+003F "?" */
    0x3c, 0x42, 0x81, 0x81, 0x3, 0x1e, 0x10, 0x10,
    0x10, 0x0, 0x38, 0x38,

    /* U+0040 "@" */
    0x7f, 0x0, 0xdd, 0x29, 0x98, 0x4c, 0x26, 0x13,
    0x9, 0x4c, 0xbb, 0xc0,

    /* U+0041 "A" */
    0xe, 0x1, 0x40, 0x6c, 0xd, 0x81, 0x10, 0x63,
    0xc, 0x61, 0x4, 0x7f, 0xcc, 0x19, 0x1, 0x60,
    0x30,

    /* U+0042 "B" */
    0xfe, 0x20, 0xd0, 0x28, 0x14, 0x1b, 0xf1, 0x4,
    0x81, 0x40, 0xa0, 0x50, 0x5f, 0xc0,

    /* U+0043 "C" */
    0x3e, 0x30, 0xb0, 0x30, 0x18, 0x4, 0x2, 0x1,
    0x0, 0x80, 0xc0, 0x50, 0x47, 0xc0,

    /* U+0044 "D" */
    0xfc, 0x42, 0x41, 0x41, 0x41, 0x41, 0x41, 0x41,
    0x41, 0x41, 0x42, 0xfc,

    /* U+0045 "E" */
    0xff, 0x2, 0x4, 0x8, 0x1f, 0xe0, 0x40, 0x81,
    0x2, 0x7, 0xf0,

    /* U+0046 "F" */
    0xff, 0x2, 0x4, 0x8, 0x1f, 0xe0, 0x40, 0x81,
    0x2, 0x4, 0x0,

    /* U+0047 "G" */
    0x3e, 0x30, 0xb0, 0x30, 0x18, 0x4, 0x2, 0x7f,
    0x1, 0x80, 0xc0, 0xd0, 0xe7, 0xd0,

    /* U+0048 "H" */
    0x81, 0x81, 0x81, 0x81, 0x81, 0xff, 0x81, 0x81,
    0x81, 0x81, 0x81, 0x81,

    /* U+0049 "I" */
    0xff, 0x10, 0x10, 0x10, 0x10, 0x10, 0x10, 0x10,
    0x10, 0x10, 0x10, 0xff,

    /* U+004A "J" */
    0x7, 0x80, 0x80, 0x40, 0x20, 0x10, 0x8, 0x5,
    0x2, 0x81, 0x40, 0x90, 0x87, 0x80,

    /* U+004B "K" */
    0x83, 0x43, 0x23, 0x13, 0xb, 0x7, 0x82, 0xc1,
    0x30, 0x8c, 0x43, 0x20, 0xd0, 0x30,

    /* U+004C "L" */
    0x80, 0x80, 0x80, 0x80, 0x80, 0x80, 0x80, 0x80,
    0x80, 0x80, 0x80, 0xff,

    /* U+004D "M" */
    0xe3, 0xf1, 0xf8, 0xf4, 0x5a, 0x2d, 0x36, 0xdb,
    0x6d, 0xb6, 0xca, 0x65, 0x33, 0x90,

    /* U+004E "N" */
    0xe1, 0xe1, 0xb1, 0xb1, 0x91, 0x99, 0x99, 0x89,
    0x8d, 0x8d, 0x87, 0x87,

    /* U+004F "O" */
    0x3e, 0x31, 0xb0, 0x70, 0x18, 0xc, 0x6, 0x3,
    0x1, 0x80, 0xc0, 0xd0, 0x47, 0xc0,

    /* U+0050 "P" */
    0xfc, 0x82, 0x81, 0x81, 0x81, 0x82, 0xfc, 0x80,
    0x80, 0x80, 0x80, 0x80,

    /* U+0051 "Q" */
    0x3e, 0x31, 0xb0, 0x70, 0x18, 0xc, 0x6, 0x3,
    0x1, 0x80, 0xc0, 0x50, 0x4f, 0xe1, 0xc0, 0x40,
    0x3c,

    /* U+0052 "R" */
    0xfc, 0x82, 0x81, 0x81, 0x81, 0x83, 0xfe, 0x81,
    0x81, 0x81, 0x81, 0x81,

    /* U+0053 "S" */
    0x1e, 0x30, 0x90, 0x28, 0x16, 0x1, 0xf0, 0x3d,
    0x3, 0x80, 0xc0, 0x50, 0x47, 0xc0,

    /* U+0054 "T" */
    0xff, 0x84, 0x2, 0x1, 0x0, 0x80, 0x40, 0x20,
    0x10, 0x8, 0x4, 0x2, 0x1, 0x0,

    /* U+0055 "U" */
    0x81, 0x81, 0x81, 0x81, 0x81, 0x81, 0x81, 0x81,
    0x81, 0x81, 0x42, 0x3c,

    /* U+0056 "V" */
    0x40, 0x4c, 0x19, 0x83, 0x10, 0x42, 0x8, 0x63,
    0xc, 0x60, 0x88, 0x1b, 0x3, 0x60, 0x28, 0x7,
    0x0,

    /* U+0057 "W" */
    0xce, 0x79, 0x4f, 0x29, 0xa5, 0x24, 0xa4, 0x94,
    0x96, 0xd2, 0xda, 0x7b, 0x4f, 0x39, 0xc7, 0x38,
    0xe0,

    /* U+0058 "X" */
    0xc1, 0xa0, 0x98, 0xc4, 0xc3, 0x60, 0xe0, 0x50,
    0x6c, 0x22, 0x31, 0x90, 0x58, 0x30,

    /* U+0059 "Y" */
    0xc1, 0xe0, 0xd0, 0xcc, 0x62, 0x21, 0xb0, 0x50,
    0x38, 0x8, 0x4, 0x2, 0x1, 0x0,

    /* U+005A "Z" */
    0xff, 0x80, 0x40, 0x40, 0x60, 0x60, 0x60, 0x60,
    0x60, 0x60, 0x20, 0x20, 0x1f, 0xf0,

    /* U+005B "[" */
    0xf2, 0x49, 0x24, 0x92, 0x49, 0x24, 0x9c,

    /* U+005C "\\" */
    0xc0, 0x81, 0x3, 0x2, 0x4, 0xc, 0x8, 0x10,
    0x30, 0x20, 0x40, 0xc0, 0x81, 0x3,

    /* U+005D "]" */
    0xe4, 0x92, 0x49, 0x24, 0x92, 0x49, 0x3c,

    /* U+005E "^" */
    0x1c, 0x1b, 0xd, 0x8c, 0x66, 0x16, 0xc,

    /* U+005F "_" */
    0xff,

    /* U+0060 "`" */
    0xcc,

    /* U+0061 "a" */
    0x3d, 0x21, 0xa0, 0x50, 0x28, 0x14, 0xa, 0x4,
    0x86, 0x3d, 0x80,

    /* U+0062 "b" */
    0x80, 0x40, 0x20, 0x17, 0xce, 0x36, 0xe, 0x3,
    0x1, 0x80, 0xe0, 0xe8, 0xd3, 0xc0,

    /* U+0063 "c" */
    0x3c, 0x43, 0xc1, 0x80, 0x80, 0x80, 0x81, 0x43,
    0x3c,

    /* U+0064 "d" */
    0x0, 0x80, 0x40, 0x27, 0xd6, 0x3e, 0xe, 0x3,
    0x1, 0x80, 0xe0, 0xd8, 0xa7, 0x90,

    /* U+0065 "e" */
    0x3c, 0x42, 0xc1, 0x81, 0xff, 0x80, 0x81, 0x42,
    0x3c,

    /* U+0066 "f" */
    0x1f, 0x10, 0x10, 0xff, 0x10, 0x10, 0x10, 0x10,
    0x10, 0x10, 0x10, 0x10,

    /* U+0067 "g" */
    0x3e, 0xb1, 0x70, 0x70, 0x18, 0xc, 0x7, 0x6,
    0xc7, 0x3e, 0x80, 0x40, 0x20, 0x17, 0xf8,

    /* U+0068 "h" */
    0x80, 0x80, 0x80, 0xbc, 0xc2, 0x81, 0x81, 0x81,
    0x81, 0x81, 0x81, 0x81,

    /* U+0069 "i" */
    0x38, 0x70, 0x7, 0x81, 0x2, 0x4, 0x8, 0x10,
    0x20, 0x47, 0xf0,

    /* U+006A "j" */
    0x1c, 0x70, 0x3e, 0x8, 0x20, 0x82, 0x8, 0x20,
    0x82, 0x8, 0x20, 0xbe,

    /* U+006B "k" */
    0x81, 0x2, 0x4, 0x28, 0xd3, 0x2c, 0x70, 0xb1,
    0x32, 0x34, 0x30,

    /* U+006C "l" */
    0xf0, 0x10, 0x10, 0x10, 0x10, 0x10, 0x10, 0x10,
    0x10, 0x10, 0x10, 0xff,

    /* U+006D "m" */
    0xb7, 0x64, 0x62, 0x31, 0x18, 0x8c, 0x46, 0x23,
    0x11, 0x88, 0x80,

    /* U+006E "n" */
    0xbc, 0xc2, 0x81, 0x81, 0x81, 0x81, 0x81, 0x81,
    0x81,

    /* U+006F "o" */
    0x3e, 0x31, 0xb0, 0x70, 0x18, 0xc, 0x7, 0x6,
    0xc6, 0x3e, 0x0,

    /* U+0070 "p" */
    0x9e, 0x51, 0xb0, 0x70, 0x18, 0xc, 0x7, 0x7,
    0xc6, 0xbe, 0x40, 0x20, 0x10, 0x8, 0x0,

    /* U+0071 "q" */
    0x3c, 0xb1, 0x70, 0x70, 0x18, 0xc, 0x7, 0x6,
    0xc7, 0x3e, 0x80, 0x40, 0x20, 0x10, 0x8,

    /* U+0072 "r" */
    0xef, 0x18, 0xc8, 0x24, 0x2, 0x1, 0x0, 0x80,
    0x40, 0xfc, 0x0,

    /* U+0073 "s" */
    0x79, 0xa, 0xf, 0x7, 0xc0, 0x60, 0xe3, 0x7c,

    /* U+0074 "t" */
    0x10, 0x10, 0x10, 0xff, 0x10, 0x10, 0x10, 0x10,
    0x10, 0x10, 0x10, 0x1f,

    /* U+0075 "u" */
    0x81, 0x81, 0x81, 0x81, 0x81, 0x81, 0x81, 0x43,
    0x3d,

    /* U+0076 "v" */
    0xc1, 0xe0, 0x90, 0xcc, 0x62, 0x21, 0xb0, 0xd8,
    0x28, 0x1c, 0x0,

    /* U+0077 "w" */
    0xce, 0x69, 0x49, 0x29, 0x25, 0x24, 0xa4, 0xf7,
    0x9e, 0xf3, 0xce, 0x31, 0x80,

    /* U+0078 "x" */
    0x41, 0x31, 0x88, 0x86, 0xc1, 0xc1, 0xb0, 0x88,
    0xc6, 0xc1, 0x80,

    /* U+0079 "y" */
    0x81, 0x81, 0x81, 0x81, 0x81, 0x81, 0x81, 0x43,
    0x3d, 0x1, 0x1, 0x1, 0x7f,

    /* U+007A "z" */
    0xfe, 0x4, 0x10, 0x41, 0x4, 0x30, 0x40, 0xfe,

    /* U+007B "{" */
    0x39, 0x8, 0x42, 0x10, 0x84, 0xe7, 0x8, 0x42,
    0x10, 0x84, 0x21, 0xc0,

    /* U+007C "|" */
    0xff, 0xff, 0xc0,

    /* U+007D "}" */
    0xe1, 0x8, 0x42, 0x10, 0x84, 0x39, 0xc8, 0x42,
    0x10, 0x84, 0x27, 0x0,

    /* U+007E "~" */
    0x38, 0xb5, 0xa3, 0x80,

    /* U+00C4 "Ä" */
    0x3f, 0xf, 0xc0, 0x0, 0x0, 0xc, 0x7, 0x81,
    0xe0, 0x48, 0x33, 0xc, 0xc2, 0x11, 0x86, 0x7f,
    0x90, 0x2c, 0xf, 0x3,

    /* U+00D6 "Ö" */
    0x77, 0x3b, 0x80, 0x0, 0x3, 0xe3, 0x1b, 0x7,
    0x1, 0x80, 0xc0, 0x60, 0x30, 0x18, 0xc, 0xd,
    0x4, 0x7c,

    /* U+00DC "Ü" */
    0x77, 0x77, 0x0, 0x0, 0x81, 0x81, 0x81, 0x81,
    0x81, 0x81, 0x81, 0x81, 0x81, 0x81, 0x42, 0x3c,

    /* U+00DF "ß" */
    0x3e, 0x31, 0x90, 0x58, 0x64, 0xf2, 0x61, 0x3c,
    0x83, 0x40, 0xa8, 0x56, 0x69, 0xe0,

    /* U+00E4 "ä" */
    0x77, 0x3b, 0x80, 0x7, 0xa4, 0x34, 0xa, 0x5,
    0x2, 0x81, 0x40, 0x90, 0xc7, 0xb0,

    /* U+00F6 "ö" */
    0x77, 0x3b, 0x80, 0x7, 0xc6, 0x36, 0xe, 0x3,
    0x1, 0x80, 0xe0, 0xd8, 0xc7, 0xc0,

    /* U+00FC "ü" */
    0x6e, 0x6e, 0x0, 0x0, 0x81, 0x81, 0x81, 0x81,
    0x81, 0x81, 0x81, 0x43, 0x3d
};


/*---------------------
 *  GLYPH DESCRIPTION
 *--------------------*/

static const lv_font_fmt_txt_glyph_dsc_t glyph_dsc[] = {
    {.bitmap_index = 0, .adv_w = 0, .box_w = 0, .box_h = 0, .ofs_x = 0, .ofs_y = 0} /* id = 0 reserved */,
    {.bitmap_index = 0, .adv_w = 176, .box_w = 1, .box_h = 1, .ofs_x = 0, .ofs_y = 0},
    {.bitmap_index = 1, .adv_w = 176, .box_w = 3, .box_h = 12, .ofs_x = 4, .ofs_y = 0},
    {.bitmap_index = 6, .adv_w = 176, .box_w = 6, .box_h = 4, .ofs_x = 3, .ofs_y = 8},
    {.bitmap_index = 9, .adv_w = 176, .box_w = 8, .box_h = 9, .ofs_x = 1, .ofs_y = 3},
    {.bitmap_index = 18, .adv_w = 176, .box_w = 7, .box_h = 11, .ofs_x = 2, .ofs_y = 1},
    {.bitmap_index = 28, .adv_w = 176, .box_w = 9, .box_h = 12, .ofs_x = 1, .ofs_y = 0},
    {.bitmap_index = 42, .adv_w = 176, .box_w = 10, .box_h = 12, .ofs_x = 1, .ofs_y = 0},
    {.bitmap_index = 57, .adv_w = 176, .box_w = 3, .box_h = 4, .ofs_x = 4, .ofs_y = 8},
    {.bitmap_index = 59, .adv_w = 176, .box_w = 7, .box_h = 18, .ofs_x = 3, .ofs_y = -3},
    {.bitmap_index = 75, .adv_w = 176, .box_w = 7, .box_h = 18, .ofs_x = 1, .ofs_y = -3},
    {.bitmap_index = 91, .adv_w = 176, .box_w = 9, .box_h = 9, .ofs_x = 1, .ofs_y = 2},
    {.bitmap_index = 102, .adv_w = 176, .box_w = 8, .box_h = 7, .ofs_x = 2, .ofs_y = 2},
    {.bitmap_index = 109, .adv_w = 176, .box_w = 3, .box_h = 4, .ofs_x = 4, .ofs_y = -2},
    {.bitmap_index = 111, .adv_w = 176, .box_w = 5, .box_h = 1, .ofs_x = 3, .ofs_y = 4},
    {.bitmap_index = 112, .adv_w = 176, .box_w = 3, .box_h = 2, .ofs_x = 4, .ofs_y = 0},
    {.bitmap_index = 113, .adv_w = 176, .box_w = 7, .box_h = 16, .ofs_x = 2, .ofs_y = -2},
    {.bitmap_index = 127, .adv_w = 176, .box_w = 9, .box_h = 12, .ofs_x = 1, .ofs_y = 0},
    {.bitmap_index = 141, .adv_w = 176, .box_w = 9, .box_h = 12, .ofs_x = 1, .ofs_y = 0},
    {.bitmap_index = 155, .adv_w = 176, .box_w = 8, .box_h = 12, .ofs_x = 1, .ofs_y = 0},
    {.bitmap_index = 167, .adv_w = 176, .box_w = 8, .box_h = 12, .ofs_x = 1, .ofs_y = 0},
    {.bitmap_index = 179, .adv_w = 176, .box_w = 9, .box_h = 12, .ofs_x = 1, .ofs_y = 0},
    {.bitmap_index = 193, .adv_w = 176, .box_w = 8, .box_h = 12, .ofs_x = 1, .ofs_y = 0},
    {.bitmap_index = 205, .adv_w = 176, .box_w = 8, .box_h = 12, .ofs_x = 1, .ofs_y = 0},
    {.bitmap_index = 217, .adv_w = 176, .box_w = 8, .box_h = 12, .ofs_x = 1, .ofs_y = 0},
    {.bitmap_index = 229, .adv_w = 176, .box_w = 8, .box_h = 12, .ofs_x = 1, .ofs_y = 0},
    {.bitmap_index = 241, .adv_w = 176, .box_w = 8, .box_h = 12, .ofs_x = 1, .ofs_y = 0},
    {.bitmap_index = 253, .adv_w = 176, .box_w = 3, .box_h = 9, .ofs_x = 4, .ofs_y = 0},
    {.bitmap_index = 257, .adv_w = 176, .box_w = 3, .box_h = 11, .ofs_x = 4, .ofs_y = -2},
    {.bitmap_index = 262, .adv_w = 176, .box_w = 8, .box_h = 8, .ofs_x = 2, .ofs_y = 2},
    {.bitmap_index = 270, .adv_w = 176, .box_w = 8, .box_h = 4, .ofs_x = 2, .ofs_y = 4},
    {.bitmap_index = 274, .adv_w = 176, .box_w = 8, .box_h = 8, .ofs_x = 2, .ofs_y = 2},
    {.bitmap_index = 282, .adv_w = 176, .box_w = 8, .box_h = 12, .ofs_x = 1, .ofs_y = 0},
    {.bitmap_index = 294, .adv_w = 176, .box_w = 9, .box_h = 10, .ofs_x = 1, .ofs_y = 0},
    {.bitmap_index = 306, .adv_w = 176, .box_w = 11, .box_h = 12, .ofs_x = 0, .ofs_y = 0},
    {.bitmap_index = 323, .adv_w = 176, .box_w = 9, .box_h = 12, .ofs_x = 1, .ofs_y = 0},
    {.bitmap_index = 337, .adv_w = 176, .box_w = 9, .box_h = 12, .ofs_x = 1, .ofs_y = 0},
    {.bitmap_index = 351, .adv_w = 176, .box_w = 8, .box_h = 12, .ofs_x = 1, .ofs_y = 0},
    {.bitmap_index = 363, .adv_w = 176, .box_w = 7, .box_h = 12, .ofs_x = 2, .ofs_y = 0},
    {.bitmap_index = 374, .adv_w = 176, .box_w = 7, .box_h = 12, .ofs_x = 2, .ofs_y = 0},
    {.bitmap_index = 385, .adv_w = 176, .box_w = 9, .box_h = 12, .ofs_x = 1, .ofs_y = 0},
    {.bitmap_index = 399, .adv_w = 176, .box_w = 8, .box_h = 12, .ofs_x = 1, .ofs_y = 0},
    {.bitmap_index = 411, .adv_w = 176, .box_w = 8, .box_h = 12, .ofs_x = 2, .ofs_y = 0},
    {.bitmap_index = 423, .adv_w = 176, .box_w = 9, .box_h = 12, .ofs_x = 1, .ofs_y = 0},
    {.bitmap_index = 437, .adv_w = 176, .box_w = 9, .box_h = 12, .ofs_x = 2, .ofs_y = 0},
    {.bitmap_index = 451, .adv_w = 176, .box_w = 8, .box_h = 12, .ofs_x = 2, .ofs_y = 0},
    {.bitmap_index = 463, .adv_w = 176, .box_w = 9, .box_h = 12, .ofs_x = 1, .ofs_y = 0},
    {.bitmap_index = 477, .adv_w = 176, .box_w = 8, .box_h = 12, .ofs_x = 1, .ofs_y = 0},
    {.bitmap_index = 489, .adv_w = 176, .box_w = 9, .box_h = 12, .ofs_x = 1, .ofs_y = 0},
    {.bitmap_index = 503, .adv_w = 176, .box_w = 8, .box_h = 12, .ofs_x = 2, .ofs_y = 0},
    {.bitmap_index = 515, .adv_w = 176, .box_w = 9, .box_h = 15, .ofs_x = 1, .ofs_y = -3},
    {.bitmap_index = 532, .adv_w = 176, .box_w = 8, .box_h = 12, .ofs_x = 2, .ofs_y = 0},
    {.bitmap_index = 544, .adv_w = 176, .box_w = 9, .box_h = 12, .ofs_x = 1, .ofs_y = 0},
    {.bitmap_index = 558, .adv_w = 176, .box_w = 9, .box_h = 12, .ofs_x = 1, .ofs_y = 0},
    {.bitmap_index = 572, .adv_w = 176, .box_w = 8, .box_h = 12, .ofs_x = 1, .ofs_y = 0},
    {.bitmap_index = 584, .adv_w = 176, .box_w = 11, .box_h = 12, .ofs_x = 0, .ofs_y = 0},
    {.bitmap_index = 601, .adv_w = 176, .box_w = 11, .box_h = 12, .ofs_x = 0, .ofs_y = 0},
    {.bitmap_index = 618, .adv_w = 176, .box_w = 9, .box_h = 12, .ofs_x = 1, .ofs_y = 0},
    {.bitmap_index = 632, .adv_w = 176, .box_w = 9, .box_h = 12, .ofs_x = 1, .ofs_y = 0},
    {.bitmap_index = 646, .adv_w = 176, .box_w = 9, .box_h = 12, .ofs_x = 1, .ofs_y = 0},
    {.bitmap_index = 660, .adv_w = 176, .box_w = 3, .box_h = 18, .ofs_x = 5, .ofs_y = -3},
    {.bitmap_index = 667, .adv_w = 176, .box_w = 7, .box_h = 16, .ofs_x = 2, .ofs_y = -2},
    {.bitmap_index = 681, .adv_w = 176, .box_w = 3, .box_h = 18, .ofs_x = 3, .ofs_y = -3},
    {.bitmap_index = 688, .adv_w = 176, .box_w = 9, .box_h = 6, .ofs_x = 1, .ofs_y = 7},
    {.bitmap_index = 695, .adv_w = 176, .box_w = 8, .box_h = 1, .ofs_x = 1, .ofs_y = -2},
    {.bitmap_index = 696, .adv_w = 176, .box_w = 3, .box_h = 2, .ofs_x = 4, .ofs_y = 10},
    {.bitmap_index = 697, .adv_w = 176, .box_w = 9, .box_h = 9, .ofs_x = 1, .ofs_y = 0},
    {.bitmap_index = 708, .adv_w = 176, .box_w = 9, .box_h = 12, .ofs_x = 1, .ofs_y = 0},
    {.bitmap_index = 722, .adv_w = 176, .box_w = 8, .box_h = 9, .ofs_x = 1, .ofs_y = 0},
    {.bitmap_index = 731, .adv_w = 176, .box_w = 9, .box_h = 12, .ofs_x = 1, .ofs_y = 0},
    {.bitmap_index = 745, .adv_w = 176, .box_w = 8, .box_h = 9, .ofs_x = 1, .ofs_y = 0},
    {.bitmap_index = 754, .adv_w = 176, .box_w = 8, .box_h = 12, .ofs_x = 1, .ofs_y = 0},
    {.bitmap_index = 766, .adv_w = 176, .box_w = 9, .box_h = 13, .ofs_x = 1, .ofs_y = -4},
    {.bitmap_index = 781, .adv_w = 176, .box_w = 8, .box_h = 12, .ofs_x = 2, .ofs_y = 0},
    {.bitmap_index = 793, .adv_w = 176, .box_w = 7, .box_h = 12, .ofs_x = 2, .ofs_y = 0},
    {.bitmap_index = 804, .adv_w = 176, .box_w = 6, .box_h = 16, .ofs_x = 3, .ofs_y = -4},
    {.bitmap_index = 816, .adv_w = 176, .box_w = 7, .box_h = 12, .ofs_x = 2, .ofs_y = 0},
    {.bitmap_index = 827, .adv_w = 176, .box_w = 8, .box_h = 12, .ofs_x = 2, .ofs_y = 0},
    {.bitmap_index = 839, .adv_w = 176, .box_w = 9, .box_h = 9, .ofs_x = 1, .ofs_y = 0},
    {.bitmap_index = 850, .adv_w = 176, .box_w = 8, .box_h = 9, .ofs_x = 2, .ofs_y = 0},
    {.bitmap_index = 859, .adv_w = 176, .box_w = 9, .box_h = 9, .ofs_x = 1, .ofs_y = 0},
    {.bitmap_index = 870, .adv_w = 176, .box_w = 9, .box_h = 13, .ofs_x = 1, .ofs_y = -4},
    {.bitmap_index = 885, .adv_w = 176, .box_w = 9, .box_h = 13, .ofs_x = 1, .ofs_y = -4},
    {.bitmap_index = 900, .adv_w = 176, .box_w = 9, .box_h = 9, .ofs_x = 1, .ofs_y = 0},
    {.bitmap_index = 911, .adv_w = 176, .box_w = 7, .box_h = 9, .ofs_x = 2, .ofs_y = 0},
    {.bitmap_index = 919, .adv_w = 176, .box_w = 8, .box_h = 12, .ofs_x = 1, .ofs_y = 0},
    {.bitmap_index = 931, .adv_w = 176, .box_w = 8, .box_h = 9, .ofs_x = 1, .ofs_y = 0},
    {.bitmap_index = 940, .adv_w = 176, .box_w = 9, .box_h = 9, .ofs_x = 1, .ofs_y = 0},
    {.bitmap_index = 951, .adv_w = 176, .box_w = 11, .box_h = 9, .ofs_x = 0, .ofs_y = 0},
    {.bitmap_index = 964, .adv_w = 176, .box_w = 9, .box_h = 9, .ofs_x = 1, .ofs_y = 0},
    {.bitmap_index = 975, .adv_w = 176, .box_w = 8, .box_h = 13, .ofs_x = 2, .ofs_y = -4},
    {.bitmap_index = 988, .adv_w = 176, .box_w = 7, .box_h = 9, .ofs_x = 2, .ofs_y = 0},
    {.bitmap_index = 996, .adv_w = 176, .box_w = 5, .box_h = 18, .ofs_x = 3, .ofs_y = -3},
    {.bitmap_index = 1008, .adv_w = 176, .box_w = 1, .box_h = 18, .ofs_x = 5, .ofs_y = -3},
    {.bitmap_index = 1011, .adv_w = 176, .box_w = 5, .box_h = 18, .ofs_x = 3, .ofs_y = -3},
    {.bitmap_index = 1023, .adv_w = 176, .box_w = 9, .box_h = 3, .ofs_x = 1, .ofs_y = 4},
    {.bitmap_index = 1027, .adv_w = 176, .box_w = 10, .box_h = 16, .ofs_x = 0, .ofs_y = 0},
    {.bitmap_index = 1047, .adv_w = 176, .box_w = 9, .box_h = 16, .ofs_x = 1, .ofs_y = 0},
    {.bitmap_index = 1065, .adv_w = 176, .box_w = 8, .box_h = 16, .ofs_x = 1, .ofs_y = 0},
    {.bitmap_index = 1081, .adv_w = 176, .box_w = 9, .box_h = 12, .ofs_x = 1, .ofs_y = 0},
    {.bitmap_index = 1095, .adv_w = 176, .box_w = 9, .box_h = 12, .ofs_x = 1, .ofs_y = 0},
    {.bitmap_index = 1109, .adv_w = 176, .box_w = 9, .box_h = 12, .ofs_x = 1, .ofs_y = 0},
    {.bitmap_index = 1123, .adv_w = 176, .box_w = 8, .box_h = 13, .ofs_x = 1, .ofs_y = 0}
};

/*---------------------
 *  CHARACTER MAPPING
 *--------------------*/

static const uint16_t unicode_list_1[] = {
    0x0, 0x12, 0x18, 0x1b, 0x20, 0x32, 0x38
};

/*Collect the unicode lists and glyph_id offsets*/
static const lv_font_fmt_txt_cmap_t cmaps[] =
{
    {
        .range_start = 32, .range_length = 95, .glyph_id_start = 1,
        .unicode_list = NULL, .glyph_id_ofs_list = NULL, .list_length = 0, .type = LV_FONT_FMT_TXT_CMAP_FORMAT0_TINY
    },
    {
        .range_start = 196, .range_length = 57, .glyph_id_start = 96,
        .unicode_list = unicode_list_1, .glyph_id_ofs_list = NULL, .list_length = 7, .type = LV_FONT_FMT_TXT_CMAP_SPARSE_TINY
    }
};



/*--------------------
 *  ALL CUSTOM DATA
 *--------------------*/

#if LV_VERSION_CHECK(8, 0, 0)
/*Store all the custom data of the font*/
static  lv_font_fmt_txt_glyph_cache_t cache;
static const lv_font_fmt_txt_dsc_t font_dsc = {
#else
static lv_font_fmt_txt_dsc_t font_dsc = {
#endif
    .glyph_bitmap = glyph_bitmap,
    .glyph_dsc = glyph_dsc,
    .cmaps = cmaps,
    .kern_dsc = NULL,
    .kern_scale = 0,
    .cmap_num = 2,
    .bpp = 1,
    .kern_classes = 0,
    .bitmap_format = 0,
#if LV_VERSION_CHECK(8, 0, 0)
    .cache = &cache
#endif
};


/*-----------------
 *  PUBLIC FONT
 *----------------*/

/*Initialize a public general font descriptor*/
#if LV_VERSION_CHECK(8, 0, 0)
const lv_font_t font_space_mono_regular_18 = {
#else
lv_font_t font_space_mono_regular_18 = {
#endif
    .get_glyph_dsc = lv_font_get_glyph_dsc_fmt_txt,    /*Function pointer to get glyph's data*/
    .get_glyph_bitmap = lv_font_get_bitmap_fmt_txt,    /*Function pointer to get glyph's bitmap*/
    .line_height = 20,          /*The maximum line height required by the font*/
    .base_line = 4,             /*Baseline measured from the bottom of the line*/
#if !(LVGL_VERSION_MAJOR == 6 && LVGL_VERSION_MINOR == 0)
    .subpx = LV_FONT_SUBPX_NONE,
#endif
#if LV_VERSION_CHECK(7, 4, 0) || LVGL_VERSION_MAJOR >= 8
    .underline_position = -1,
    .underline_thickness = 1,
#endif
    .dsc = &font_dsc           /*The custom font data. Will be accessed by `get_glyph_bitmap/dsc` */
};



#endif /*#if FONT_SPACE_MONO_REGULAR_18*/
```
